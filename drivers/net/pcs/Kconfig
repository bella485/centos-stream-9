## drivers/net/pcs/Kconfig
```kconfig
# SPDX-License-Identifier: GPL-2.0-only
#
# PCS Layer Configuration
#

menu "PCS device drivers"

config PCS_XPCS
	tristate
	select PHYLINK
	help
	  This module provides helper functions for Synopsys DesignWare XPCS
	  controllers.

config PCS_LYNX
	tristate
	help
	  This module provides helpers to phylink for managing the Lynx PCS
	  which is part of the Layerscape and QorIQ Ethernet SERDES.

config PCS_ALTERA_TSE
	tristate
	help
	  This module provides helper functions for the Altera Triple Speed
	  Ethernet SGMII PCS, that can be found on the Intel Socfpga family.

endmenu
```
